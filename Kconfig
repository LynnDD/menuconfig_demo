## Kconfig
```kconfig
#menu "MENUCONFIG DEMO"

mainmenu "MENUCONFIG DEMO CONFIGURATION"

	menu "application"
		source "src/application/Kconfig"
	endmenu

	menu "driver"
		source "src/driver/Kconfig"
	endmenu

#endmenu
```

## src/application/Kconfig
```kconfig
# SPDX-License-Identifier: BSD-3-Clause

config LOADER
    bool "Loader project"
    default n

config PSRAM
    bool "PSRAM project"
    default n
```
